## firmware/build/firmware/Kconfig/Kconfig.sysbuild.modules
```kconfig
menu "nrf (/home/thiago/ncs/v2.6.0/nrf)"
osource "/home/thiago/ncs/v2.6.0/nrf/sysbuild/Kconfig.sysbuild"
config ZEPHYR_NRF_MODULE
	bool
	default y
endmenu
```
