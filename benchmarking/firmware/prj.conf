## CMakeLists.txt
```
cmake_minimum_required(VERSION 3.20.0)

set(BOARD_FLASH_RUNNER nrfutil CACHE STRING "Use nrfutil for west flash" FORCE)

set(PROJECT_ROOT "${CMAKE_CURRENT_SOURCE_DIR}/../..")
set(WOLFSSL_MODULE "${PROJECT_ROOT}/modules/wolfssl" CACHE PATH "wolfSSL module path")
set(WOLFMQTT_MODULE "${PROJECT_ROOT}/modules/wolfmqtt" CACHE PATH "wolfMQTT module path")
set(PQM4_MODULE "${PROJECT_ROOT}/modules/pqm4" CACHE PATH "pqm4 module path")
set(BENCH_GENERATED_DIR "${CMAKE_CURRENT_SOURCE_DIR}/../work/generated/default" CACHE PATH "Generated benchmark headers")

set(WOLFSSL_MLKEM "yes" CACHE STRING "Enable wolfSSL ML-KEM for TLS 1.3 PQC key exchange")
set(WOLFSSL_PQC_HYBRIDS "yes" CACHE STRING "Enable classical/PQC hybrid TLS groups")
set(WOLFSSL_TLS_NO_MLKEM_STANDALONE "no" CACHE STRING "Allow standalone ML-KEM TLS groups")

if(EXISTS "${WOLFSSL_MODULE}/zephyr/module.yml")
  list(APPEND ZEPHYR_EXTRA_MODULES "${WOLFSSL_MODULE}")
endif()

if(EXISTS "${WOLFMQTT_MODULE}/zephyr/module.yml")
  list(APPEND ZEPHYR_EXTRA_MODULES "${WOLFMQTT_MODULE}")
endif()

find_package(Zephyr REQUIRED HINTS $ENV{ZEPHYR_BASE})
project(ipsp_mqtt_tls_wolf_benchmark)

if(CONFIG_APP_BENCH_TLS_GROUP_UNIVERSAL)
  set(BENCH_TLS_GROUP "universal-kem")
  set(BENCH_TLS_GROUP_ID "0")
  set(BENCH_TLS_GROUP_UNIVERSAL 1)
elseif(CONFIG_APP_BENCH_TLS_GROUP_MLKEM512)
  set(BENCH_TLS_GROUP "MLKEM512")
  set(BENCH_TLS_GROUP_ID "WOLFSSL_ML_KEM_512")
  set(BENCH_TLS_GROUP_UNIVERSAL 0)
elseif(CONFIG_APP_BENCH_TLS_GROUP_MLKEM768)
  set(BENCH_TLS_GROUP "MLKEM768")
  set(BENCH_TLS_GROUP_ID "WOLFSSL_ML_KEM_768")
  set(BENCH_TLS_GROUP_UNIVERSAL 0)
elseif(CONFIG_APP_BENCH_TLS_GROUP_MLKEM1024)
  set(BENCH_TLS_GROUP "MLKEM1024")
  set(BENCH_TLS_GROUP_ID "WOLFSSL_ML_KEM_1024")
  set(BENCH_TLS_GROUP_UNIVERSAL 0)
elseif(CONFIG_APP_BENCH_TLS_GROUP_SECP256R1_MLKEM768)
  set(BENCH_TLS_GROUP "SecP256r1MLKEM768")
  set(BENCH_TLS_GROUP_ID "WOLFSSL_SECP256R1MLKEM768")
  set(BENCH_TLS_GROUP_UNIVERSAL 0)
elseif(CONFIG_APP_BENCH_TLS_GROUP_X25519_MLKEM768)
  set(BENCH_TLS_GROUP "X25519MLKEM768")
  set(BENCH_TLS_GROUP_ID "WOLFSSL_X25519MLKEM768")
  set(BENCH_TLS_GROUP_UNIVERSAL 0)
elseif(CONFIG_APP_BENCH_TLS_GROUP_SECP384R1_MLKEM1024)
  set(BENCH_TLS_GROUP "SecP384r1MLKEM1024")
  set(BENCH_TLS_GROUP_ID "WOLFSSL_SECP384R1MLKEM1024")
  set(BENCH_TLS_GROUP_UNIVERSAL 0)
elseif(CONFIG_APP_BENCH_TLS_GROUP_ECDHE_P256)
  set(BENCH_TLS_GROUP "ECDHE-P-256")
  set(BENCH_TLS_GROUP_ID "WOLFSSL_ECC_SECP256R1")
  set(BENCH_TLS_GROUP_UNIVERSAL 0)
elseif(CONFIG_APP_BENCH_TLS_GROUP_ECDHE_P384)
  set(BENCH_TLS_GROUP "ECDHE-P-384")
  set(BENCH_TLS_GROUP_ID "WOLFSSL_ECC_SECP384R1")
  set(BENCH_TLS_GROUP_UNIVERSAL 0)
elseif(CONFIG_APP_BENCH_TLS_GROUP_ECDHE_P521)
  set(BENCH_TLS_GROUP "ECDHE-P-521")
  set(BENCH_TLS_GROUP_ID "WOLFSSL_ECC_SECP521R1")
  set(BENCH_TLS_GROUP_UNIVERSAL 0)
else()
  message(FATAL_ERROR "No benchmark TLS group selected")
endif()

target_sources(app PRIVATE src/main.c)
target_include_directories(app PRIVATE ${BENCH_GENERATED_DIR} ${CMAKE_CURRENT_SOURCE_DIR}/src)
target_compile_definitions(app PRIVATE
  APP_TLS_GROUP_ID=${BENCH_TLS_GROUP_ID}
  APP_TLS_GROUP_NAME="${BENCH_TLS_GROUP}"
  APP_TLS_GROUP_UNIVERSAL=${BENCH_TLS_GROUP_UNIVERSAL}
)

if(CONFIG_APP_BENCH_MLKEM_BACKEND_PQM4_CLEAN)
  set(PQM4_PQCLEAN_DIR "${PQM4_MODULE}/mupq/pqclean")
  set(PQM4_COMMON_DIR "${PQM4_PQCLEAN_DIR}/common")

  if(NOT EXISTS "${PQM4_COMMON_DIR}/fips202.c")
    message(FATAL_ERROR "pqm4 PQClean sources not found at ${PQM4_PQCLEAN_DIR}")
  endif()

  add_library(pqm4_pqclean_common OBJECT
    "${PQM4_COMMON_DIR}/fips202.c"
    src/pqm4_randombytes.c
  )
  target_include_directories(pqm4_pqclean_common PRIVATE
    ${CMAKE_CURRENT_SOURCE_DIR}/src
    "${PQM4_COMMON_DIR}"
  )
  target_link_libraries(pqm4_pqclean_common PRIVATE zephyr_interface)

  function(add_pqm4_mlkem_clean target level)
    set(level_dir "${PQM4_PQCLEAN_DIR}/crypto_kem/ml-kem-${level}/clean")
    add_library(${target} OBJECT
      "${level_dir}/cbd.c"
      "${level_dir}/indcpa.c"
      "${level_dir}/kem.c"
      "${level_dir}/ntt.c"
      "${level_dir}/poly.c"
      "${level_dir}/polyvec.c"
      "${level_dir}/reduce.c"
      "${level_dir}/symmetric-shake.c"
      "${level_dir}/verify.c"
    )
    target_include_directories(${target} PRIVATE
      ${CMAKE_CURRENT_SOURCE_DIR}/src
      "${level_dir}"
      "${PQM4_COMMON_DIR}"
    )
    target_link_libraries(${target} PRIVATE zephyr_interface)
  endfunction()

  add_pqm4_mlkem_clean(pqm4_mlkem512_clean 512)
  add_pqm4_mlkem_clean(pqm4_mlkem768_clean 768)
  add_pqm4_mlkem_clean(pqm4_mlkem1024_clean 1024)

  target_sources(app PRIVATE
    src/pqm4_mlkem_backend.c
    $<TARGET_OBJECTS:pqm4_pqclean_common>
    $<TARGET_OBJECTS:pqm4_mlkem512_clean>
    $<TARGET_OBJECTS:pqm4_mlkem768_clean>
    $<TARGET_OBJECTS:pqm4_mlkem1024_clean>
  )
  target_compile_definitions(app PRIVATE APP_MLKEM_BACKEND_NAME="pqm4-clean")
else()
  target_compile_definitions(app PRIVATE APP_MLKEM_BACKEND_NAME="wolfssl")
endif()
```

## Kconfig
```
source "Kconfig.zephyr"

menu "Benchmark MQTT/TLS settings"

config APP_MQTT_BROKER_HOST
	string "MQTT broker IPv6 address"
	default "2001:db8::2"

config APP_MQTT_BROKER_PORT
	int "MQTT TLS broker port"
	default 8883

config APP_MQTT_CLIENT_ID
	string "MQTT client ID"
	default "nrf52840-benchmark"

config APP_MQTT_TELEMETRY_TOPIC
	string "MQTT telemetry topic"
	default "nrf52840/benchmark/telemetry"

config APP_MQTT_COMMAND_TOPIC
	string "MQTT command topic"
	default "nrf52840/benchmark/command"

config APP_MQTT_CMD_TIMEOUT_MS
	int "wolfMQTT command timeout in milliseconds"
	default 15000

config APP_TLS_HANDSHAKE_TIMEOUT_MS
	int "TLS handshake timeout in milliseconds"
	default 300000

config APP_TLS_IO_TIMEOUT_MS
	int "TLS socket I/O timeout in milliseconds"
	default 10000

config APP_MQTT_KEEPALIVE_SEC
	int "MQTT keepalive in seconds"
	default 60

config APP_BENCH_ITERATIONS
	int "Measured benchmark attempts"
	default 10

config APP_BENCH_WARMUP_ITERATIONS
	int "Warmup benchmark attempts"
	default 2

config APP_BENCH_PAUSE_MS
	int "Pause between benchmark attempts"
	default 1000

config APP_BENCH_INITIAL_DELAY_MS
	int "Delay before starting benchmark attempts"
	default 1000

config APP_BENCH_CONNECT_RETRIES
	int "Connection tries per benchmark attempt"
	default 5

config APP_BENCH_CONNECT_RETRY_DELAY_MS
	int "Delay after a failed connection try"
	default 500

config APP_BENCH_REBOOT_AFTER_ATTEMPT
	bool "Reboot after each benchmark attempt"
	default n
	help
	  Use this when the benchmark runner executes one attempt per IPSP
	  session. It gives each measured connection a fresh firmware/network
	  state without reflashing the board.

config APP_BENCH_VERBOSE_LOGS
	bool "Print verbose benchmark debug logs"
	default n
	help
	  Enable diagnostic printk output around TCP/TLS/MQTT setup and memory
	  accounting. Keep this disabled for benchmark runs to avoid serial output
	  affecting timing. Essential BENCH_* CSV lines are still printed.

config APP_BENCH_WOLFSSL_DEBUG
	bool "Print wolfSSL diagnostic logs"
	default n
	depends on APP_BENCH_VERBOSE_LOGS
	help
	  Compile wolfSSL error/debug logging for one-off diagnosis. Keep this
	  disabled during timing benchmarks because serial output changes results.

config APP_BLE_IPSP_FAST_LINK
	bool "Request faster BLE link parameters for IPSP"
	default n
	help
	  Request short BLE connection intervals, maximum data length and 2M PHY
	  when the host connects. This reduces the transport cost paid by large TLS
	  handshake flights over IPSP.

config APP_BLE_IPSP_WRITE_CHUNK
	int "Maximum socket write chunk for IPSP TLS records"
	default 256
	range 64 1220
	help
	  Upper bound for each non-blocking socket send. Larger chunks reduce
	  application-level sleeps, while the BLE/6LoWPAN stack still fragments as
	  needed.

config APP_BLE_IPSP_WRITE_PAUSE_MS
	int "Pause after transient IPSP write backpressure"
	default 1
	range 0 100

config APP_BLE_IPSP_READ_PAUSE_MS
	int "Pause after empty non-blocking IPSP read"
	default 1
	range 0 100

config APP_BLE_IPSP_FAST_LINK_DELAY_MS
	int "Delay before requesting faster BLE link parameters"
	default 1500
	range 0 10000
	help
	  Delay the optional PHY/data-length/connection-interval update so it does
	  not race the host-side IPSP L2CAP setup immediately after connecting.

choice APP_BENCH_TLS_GROUP
	prompt "TLS 1.3 key exchange group"
	default APP_BENCH_TLS_GROUP_UNIVERSAL

config APP_BENCH_TLS_GROUP_UNIVERSAL
	bool "Universal KEM list"
	help
	  Offer every benchmark-supported TLS 1.3 key exchange group from a
	  single firmware image. The benchmark server selects the actual group
	  for each case.

config APP_BENCH_TLS_GROUP_MLKEM512
	bool "MLKEM512"

config APP_BENCH_TLS_GROUP_MLKEM768
	bool "MLKEM768"

config APP_BENCH_TLS_GROUP_MLKEM1024
	bool "MLKEM1024"

config APP_BENCH_TLS_GROUP_SECP256R1_MLKEM768
	bool "SecP256r1MLKEM768"

config APP_BENCH_TLS_GROUP_X25519_MLKEM768
	bool "X25519MLKEM768"

config APP_BENCH_TLS_GROUP_SECP384R1_MLKEM1024
	bool "SecP384r1MLKEM1024"

config APP_BENCH_TLS_GROUP_ECDHE_P256
	bool "ECDHE P-256"

config APP_BENCH_TLS_GROUP_ECDHE_P384
	bool "ECDHE P-384"

config APP_BENCH_TLS_GROUP_ECDHE_P521
	bool "ECDHE P-521"

endchoice

choice APP_BENCH_MLKEM_BACKEND
	prompt "ML-KEM implementation backend"
	default APP_BENCH_MLKEM_BACKEND_WOLFSSL
	help
	  Select which implementation performs ML-KEM key generation,
	  encapsulation and decapsulation for wolfSSL TLS 1.3 ML-KEM groups.
	  This affects MLKEM512/768/1024 and hybrid groups that include ML-KEM.

config APP_BENCH_MLKEM_BACKEND_WOLFSSL
	bool "wolfSSL built-in ML-KEM"

config APP_BENCH_MLKEM_BACKEND_PQM4_CLEAN
	bool "pqm4/PQClean clean ML-KEM via wolfSSL CryptoCb"
	depends on APP_BENCH_TLS_GROUP_UNIVERSAL || APP_BENCH_TLS_GROUP_MLKEM512 || APP_BENCH_TLS_GROUP_MLKEM768 || APP_BENCH_TLS_GROUP_MLKEM1024 || APP_BENCH_TLS_GROUP_SECP256R1_MLKEM768 || APP_BENCH_TLS_GROUP_X25519_MLKEM768 || APP_BENCH_TLS_GROUP_SECP384R1_MLKEM1024
	help
	  Route wolfSSL ML-KEM operations through pqm4's vendored PQClean
	  clean implementations. TLS, X.509 verification and MQTT remain
	  handled by wolfSSL/wolfMQTT.

endchoice

endmenu
```

## prj.conf
```kconfig
CONFIG_BT=y
CONFIG_BT_SMP=y
CONFIG_BT_PERIPHERAL=y
CONFIG_BT_CENTRAL=y
CONFIG_BT_L2CAP_DYNAMIC_CHANNEL=y
CONFIG_BT_PHY_UPDATE=y
CONFIG_BT_DATA_LEN_UPDATE=y
CONFIG_BT_CONN_PARAM_UPDATE_TIMEOUT=0
CONFIG_BT_DEVICE_NAME="nRF52840 IPSP Benchmark"

CONFIG_GPIO=y
CONFIG_BOOT_BANNER=n
CONFIG_LOG=n
CONFIG_LOG_BACKEND_RTT=n
CONFIG_USE_SEGGER_RTT=n
CONFIG_ASSERT=n
CONFIG_THREAD_NAME=y
CONFIG_MAIN_STACK_SIZE=32768
CONFIG_SYSTEM_WORKQUEUE_STACK_SIZE=4096
CONFIG_BT_RX_STACK_SIZE=4096
CONFIG_HEAP_MEM_POOL_SIZE=98304
CONFIG_SYS_HEAP_RUNTIME_STATS=y
CONFIG_THREAD_RUNTIME_STATS=y
CONFIG_THREAD_RUNTIME_STATS_USE_TIMING_FUNCTIONS=y
CONFIG_SCHED_THREAD_USAGE=y
CONFIG_SCHED_THREAD_USAGE_ALL=y

CONFIG_NETWORKING=y
CONFIG_NET_IPV6=y
CONFIG_NET_IPV4=n
CONFIG_NET_TCP=y
CONFIG_NET_UDP=y
CONFIG_NET_SOCKETS=y
CONFIG_NET_L2_BT=y
CONFIG_INIT_STACKS=y
CONFIG_TEST_RANDOM_GENERATOR=y
CONFIG_NET_TCP_ACK_TIMEOUT=5000
CONFIG_NET_TCP_INIT_RETRANSMISSION_TIMEOUT=2000
CONFIG_NET_TCP_RETRY_COUNT=12
CONFIG_NET_TCP_MAX_SEND_WINDOW_SIZE=2048
CONFIG_NET_TCP_MAX_RECV_WINDOW_SIZE=2048

CONFIG_NET_PKT_RX_COUNT=16
CONFIG_NET_PKT_TX_COUNT=16
CONFIG_NET_BUF_RX_COUNT=32
CONFIG_NET_BUF_TX_COUNT=32
CONFIG_NET_IF_UNICAST_IPV6_ADDR_COUNT=3
CONFIG_NET_IF_MCAST_IPV6_ADDR_COUNT=4
CONFIG_NET_MAX_CONTEXTS=6

CONFIG_NET_CONFIG_AUTO_INIT=n
CONFIG_NET_CONFIG_SETTINGS=y
CONFIG_NET_CONFIG_MY_IPV6_ADDR="2001:db8::1"
CONFIG_NET_CONFIG_PEER_IPV6_ADDR="2001:db8::2"
CONFIG_NET_CONFIG_BT_NODE=y

CONFIG_POSIX_API=y
CONFIG_POSIX_CLOCK=y
CONFIG_PTHREAD_IPC=y

CONFIG_WOLFSSL=y
CONFIG_WOLFSSL_BUILTIN=y
CONFIG_WOLFSSL_MLKEM=y
CONFIG_WOLFSSL_SETTINGS_FILE="user_settings.h"

CONFIG_WOLFMQTT=y
CONFIG_WOLFMQTT_TLS=y
CONFIG_WOLFMQTT_SETTINGS_FILE="wolfmqtt_settings.h"

CONFIG_APP_MQTT_BROKER_HOST="2001:db8::2"
CONFIG_APP_MQTT_BROKER_PORT=8883
CONFIG_APP_MQTT_CLIENT_ID="nrf52840-benchmark"
CONFIG_APP_MQTT_TELEMETRY_TOPIC="nrf52840/benchmark/telemetry"
CONFIG_APP_MQTT_COMMAND_TOPIC="nrf52840/benchmark/command"
```

## src/benchmark_cert.h
```c
#ifndef APP_BENCHMARK_CERT_H
#define APP_BENCHMARK_CERT_H

static const char ca_cert_pem[] =
"-----BEGIN CERTIFICATE-----\n"
"MIIBhTCCASugAwIBAgIUZnrr9RICtIu6fFaInN0+zQ7Dq58wCgYIKoZIzj0EAwIw\n"
"GDEWMBQGA1UEAwwNaXBzcC1sb2NhbC1jYTAeFw0yNjA2MDYwMjE2MTBaFw0zNjA2\n"
"MDMwMjE2MTBaMBgxFjAUBgNVBAMMDWlwc3AtbG9jYWwtY2EwWTATBgcqhkjOPQIB\n"
"BggqhkjOPQMBBwNCAAROsU80hahC70SZhS1AWrO1RD3ih18/ocS+b/m0pcxDUHAc\n"
"ryW9rr2LXkK0itqNKA2XTS69SvAOHt6+SXj3j8kyo1MwUTAdBgNVHQ4EFgQUvMjt\n"
"9a+gUm4YuB66rQBu2CY9mTkwHwYDVR0jBBgwFoAUvMjt9a+gUm4YuB66rQBu2CY9\n"
"mTkwDwYDVR0TAQH/BAUwAwEB/zAKBggqhkjOPQQDAgNIADBFAiEAzPz9aKDvx3W2\n"
"AYKiku1feWik6iBoGZAWWCY4mJKDUDkCICRKI71KE2PO1ROCuwPj8a0JjUvAG/q9\n"
"E/limeSIiScs\n"
"-----END CERTIFICATE-----\n";

#endif
```

## src/features.h
```c
#ifndef APP_BENCH_FEATURES_SHIM_H
#define APP_BENCH_FEATURES_SHIM_H

#ifndef __GNUC_PREREQ
#define __GNUC_PREREQ(maj, min) \
	((__GNUC__ > (maj)) || (__GNUC__ == (maj) && __GNUC_MINOR__ >= (min)))
#endif

#endif
```

## src/pqm4_mlkem_backend.c
```c
#include "pqm4_mlkem_backend.h"

#include <stdint.h>
#include <string.h>

#include <zephyr/sys/util.h>

#include <wolfssl/options.h>
#include <wolfssl/ssl.h>
#include <wolfssl/wolfcrypt/cryptocb.h>
#include <wolfssl/wolfcrypt/error-crypt.h>
#include <wolfssl/wolfcrypt/random.h>
#include <wolfssl/wolfcrypt/wc_mlkem.h>

#define PQM4_MLKEM_DEV_ID 42040
#define MLKEM_KEYPAIR_RANDOM_BYTES 64
#define MLKEM_ENCAPS_RANDOM_BYTES 32

int PQCLEAN_MLKEM512_CLEAN_crypto_kem_keypair_derand(uint8_t *pk, uint8_t *sk,
						     const uint8_t *coins);
int PQCLEAN_MLKEM512_CLEAN_crypto_kem_enc_derand(uint8_t *ct, uint8_t *ss,
						 const uint8_t *pk,
						 const uint8_t *coins);
int PQCLEAN_MLKEM512_CLEAN_crypto_kem_dec(uint8_t *ss, const uint8_t *ct,
					  const uint8_t *sk);

int PQCLEAN_MLKEM768_CLEAN_crypto_kem_keypair_derand(uint8_t *pk, uint8_t *sk,
						     const uint8_t *coins);
int PQCLEAN_MLKEM768_CLEAN_crypto_kem_enc_derand(uint8_t *ct, uint8_t *ss,
						 const uint8_t *pk,
						 const uint8_t *coins);
int PQCLEAN_MLKEM768_CLEAN_crypto_kem_dec(uint8_t *ss, const uint8_t *ct,
					  const uint8_t *sk);

int PQCLEAN_MLKEM1024_CLEAN_crypto_kem_keypair_derand(uint8_t *pk, uint8_t *sk,
						      const uint8_t *coins);
int PQCLEAN_MLKEM1024_CLEAN_crypto_kem_enc_derand(uint8_t *ct, uint8_t *ss,
						  const uint8_t *pk,
						  const uint8_t *coins);
int PQCLEAN_MLKEM1024_CLEAN_crypto_kem_dec(uint8_t *ss, const uint8_t *ct,
					   const uint8_t *sk);

struct pqm4_mlkem_level {
	int wolf_type;
	word32 public_len;
	word32 private_len;
	word32 ciphertext_len;
	int (*keypair_derand)(uint8_t *pk, uint8_t *sk, const uint8_t *coins);
	int (*enc_derand)(uint8_t *ct, uint8_t *ss, const uint8_t *pk,
			  const uint8_t *coins);
	int (*dec)(uint8_t *ss, const uint8_t *ct, const uint8_t *sk);
};

static const struct pqm4_mlkem_level mlkem_levels[] = {
	{
		.wolf_type = WC_ML_KEM_512,
		.public_len = WC_ML_KEM_512_PUBLIC_KEY_SIZE,
		.private_len = WC_ML_KEM_512_PRIVATE_KEY_SIZE,
		.ciphertext_len = WC_ML_KEM_512_CIPHER_TEXT_SIZE,
		.keypair_derand = PQCLEAN_MLKEM512_CLEAN_crypto_kem_keypair_derand,
		.enc_derand = PQCLEAN_MLKEM512_CLEAN_crypto_kem_enc_derand,
		.dec = PQCLEAN_MLKEM512_CLEAN_crypto_kem_dec,
	},
	{
		.wolf_type = WC_ML_KEM_768,
		.public_len = WC_ML_KEM_768_PUBLIC_KEY_SIZE,
		.private_len = WC_ML_KEM_768_PRIVATE_KEY_SIZE,
		.ciphertext_len = WC_ML_KEM_768_CIPHER_TEXT_SIZE,
		.keypair_derand = PQCLEAN_MLKEM768_CLEAN_crypto_kem_keypair_derand,
		.enc_derand = PQCLEAN_MLKEM768_CLEAN_crypto_kem_enc_derand,
		.dec = PQCLEAN_MLKEM768_CLEAN_crypto_kem_dec,
	},
	{
		.wolf_type = WC_ML_KEM_1024,
		.public_len = WC_ML_KEM_1024_PUBLIC_KEY_SIZE,
		.private_len = WC_ML_KEM_1024_PRIVATE_KEY_SIZE,
		.ciphertext_len = WC_ML_KEM_1024_CIPHER_TEXT_SIZE,
		.keypair_derand = PQCLEAN_MLKEM1024_CLEAN_crypto_kem_keypair_derand,
		.enc_derand = PQCLEAN_MLKEM1024_CLEAN_crypto_kem_enc_derand,
		.dec = PQCLEAN_MLKEM1024_CLEAN_crypto_kem_dec,
	},
};

static const struct pqm4_mlkem_level *level_from_key(const MlKemKey *key)
{
	int type;

	if (!key) {
		return NULL;
	}

	type = key->type;
	if (type & MLKEM_KYBER) {
		type &= ~MLKEM_KYBER;
	}

	for (size_t i = 0; i < ARRAY_SIZE(mlkem_levels); i++) {
		if (mlkem_levels[i].wolf_type == type) {
			return &mlkem_levels[i];
		}
	}

	return NULL;
}

static int rng_bytes(WC_RNG *rng, uint8_t *out, word32 out_len)
{
	if (!rng || !out) {
		return BAD_FUNC_ARG;
	}

	return wc_RNG_GenerateBlock(rng, out, out_len);
}

static int pqm4_make_key(WC_RNG *rng, MlKemKey *key)
{
	const struct pqm4_mlkem_level *level = level_from_key(key);
	uint8_t coins[MLKEM_KEYPAIR_RANDOM_BYTES];
	uint8_t *pk;
	uint8_t *sk;
	int ret;

	if (!level) {
		return CRYPTOCB_UNAVAILABLE;
	}

	pk = XMALLOC(level->public_len, key->heap, DYNAMIC_TYPE_TMP_BUFFER);
	sk = XMALLOC(level->private_len, key->heap, DYNAMIC_TYPE_TMP_BUFFER);
	if (!pk || !sk) {
		ret = MEMORY_E;
		goto out;
	}

	ret = rng_bytes(rng, coins, sizeof(coins));
	if (ret == 0) {
		ret = level->keypair_derand(pk, sk, coins);
	}
	if (ret == 0) {
		ret = wc_MlKemKey_DecodePrivateKey(key, sk, level->private_len);
	}

out:
	if (pk) {
		XMEMSET(pk, 0, level ? level->public_len : 0);
		XFREE(pk, key ? key->heap : NULL, DYNAMIC_TYPE_TMP_BUFFER);
	}
	if (sk) {
		XMEMSET(sk, 0, level ? level->private_len : 0);
		XFREE(sk, key ? key->heap : NULL, DYNAMIC_TYPE_TMP_BUFFER);
	}
	XMEMSET(coins, 0, sizeof(coins));
	return ret;
}

static int pqm4_encapsulate(WC_RNG *rng, MlKemKey *key, uint8_t *ct,
			    word32 ct_len, uint8_t *ss, word32 ss_len)
{
	const struct pqm4_mlkem_level *level = level_from_key(key);
	uint8_t coins[MLKEM_ENCAPS_RANDOM_BYTES];
	uint8_t *pk;
	int ret;

	if (!level) {
		return CRYPTOCB_UNAVAILABLE;
	}
	if (!ct || !ss || ct_len != level->ciphertext_len ||
	    ss_len != WC_ML_KEM_SS_SZ) {
		return BUFFER_E;
	}

	pk = XMALLOC(level->public_len, key->heap, DYNAMIC_TYPE_TMP_BUFFER);
	if (!pk) {
		return MEMORY_E;
	}

	ret = wc_MlKemKey_EncodePublicKey(key, pk, level->public_len);
	if (ret == 0) {
		ret = rng_bytes(rng, coins, sizeof(coins));
	}
	if (ret == 0) {
		ret = level->enc_derand(ct, ss, pk, coins);
	}

	XMEMSET(pk, 0, level->public_len);
	XFREE(pk, key->heap, DYNAMIC_TYPE_TMP_BUFFER);
	XMEMSET(coins, 0, sizeof(coins));
	return ret;
}

static int pqm4_decapsulate(MlKemKey *key, const uint8_t *ct, word32 ct_len,
			    uint8_t *ss, word32 ss_len)
{
	const struct pqm4_mlkem_level *level = level_from_key(key);
	uint8_t *sk;
	int ret;

	if (!level) {
		return CRYPTOCB_UNAVAILABLE;
	}
	if (!ct || !ss || ct_len != level->ciphertext_len ||
	    ss_len != WC_ML_KEM_SS_SZ) {
		return BUFFER_E;
	}

	sk = XMALLOC(level->private_len, key->heap, DYNAMIC_TYPE_TMP_BUFFER);
	if (!sk) {
		return MEMORY_E;
	}

	ret = wc_MlKemKey_EncodePrivateKey(key, sk, level->private_len);
	if (ret == 0) {
		ret = level->dec(ss, ct, sk);
	}

	XMEMSET(sk, 0, level->private_len);
	XFREE(sk, key->heap, DYNAMIC_TYPE_TMP_BUFFER);
	return ret;
}

static int pqm4_mlkem_crypto_cb(int dev_id, wc_CryptoInfo *info, void *ctx)
{
	ARG_UNUSED(dev_id);
	ARG_UNUSED(ctx);

	if (!info || info->algo_type != WC_ALGO_TYPE_PK) {
		return CRYPTOCB_UNAVAILABLE;
	}

	switch (info->pk.type) {
	case WC_PK_TYPE_PQC_KEM_KEYGEN:
		if (info->pk.pqc_kem_kg.type != WC_PQC_KEM_TYPE_MLKEM) {
			return CRYPTOCB_UNAVAILABLE;
		}
		return pqm4_make_key(info->pk.pqc_kem_kg.rng,
				     (MlKemKey *)info->pk.pqc_kem_kg.key);
	case WC_PK_TYPE_PQC_KEM_ENCAPS:
		if (info->pk.pqc_encaps.type != WC_PQC_KEM_TYPE_MLKEM) {
			return CRYPTOCB_UNAVAILABLE;
		}
		return pqm4_encapsulate(info->pk.pqc_encaps.rng,
					(MlKemKey *)info->pk.pqc_encaps.key,
					info->pk.pqc_encaps.ciphertext,
					info->pk.pqc_encaps.ciphertextLen,
					info->pk.pqc_encaps.sharedSecret,
					info->pk.pqc_encaps.sharedSecretLen);
	case WC_PK_TYPE_PQC_KEM_DECAPS:
		if (info->pk.pqc_decaps.type != WC_PQC_KEM_TYPE_MLKEM) {
			return CRYPTOCB_UNAVAILABLE;
		}
		return pqm4_decapsulate((MlKemKey *)info->pk.pqc_decaps.key,
					info->pk.pqc_decaps.ciphertext,
					info->pk.pqc_decaps.ciphertextLen,
					info->pk.pqc_decaps.sharedSecret,
					info->pk.pqc_decaps.sharedSecretLen);
	default:
		return CRYPTOCB_UNAVAILABLE;
	}
}

int pqm4_mlkem_backend_init(void)
{
	int ret = wolfSSL_Init();

	if (ret != WOLFSSL_SUCCESS) {
		return ret;
	}

	wc_CryptoCb_UnRegisterDevice(PQM4_MLKEM_DEV_ID);
	ret = wc_CryptoCb_RegisterDevice(PQM4_MLKEM_DEV_ID,
					 pqm4_mlkem_crypto_cb, NULL);
	if (ret == BUFFER_E) {
		wolfSSL_Cleanup();
		ret = wolfSSL_Init();
		if (ret != WOLFSSL_SUCCESS) {
			return ret;
		}
		ret = wc_CryptoCb_RegisterDevice(PQM4_MLKEM_DEV_ID,
						 pqm4_mlkem_crypto_cb, NULL);
	}

	return ret;
}

int pqm4_mlkem_backend_dev_id(void)
{
	return PQM4_MLKEM_DEV_ID;
}
```

## src/pqm4_mlkem_backend.h
```c
#ifndef APP_BENCH_PQM4_MLKEM_BACKEND_H
#define APP_BENCH_PQM4_MLKEM_BACKEND_H

int pqm4_mlkem_backend_init(void);
int pqm4_mlkem_backend_dev_id(void);

#endif
```

## src/pqm4_randombytes.c
```c
#include <stddef.h>
#include <stdint.h>

#include <zephyr/random/random.h>

int PQCLEAN_randombytes(uint8_t *output, size_t n)
{
	return sys_csrand_get(output, n);
}
```

## src/user_settings.h
```c
#ifndef APP_BENCH_WOLFSSL_USER_SETTINGS_H
#define APP_BENCH_WOLFSSL_USER_SETTINGS_H

#include <zephyr/net/socket.h>

#define WOLFSSL_TLS13
#define HAVE_TLS_EXTENSIONS
#define HAVE_SUPPORTED_CURVES
#define HAVE_ECC
#define HAVE_ECC384
#define HAVE_ECC521
#define HAVE_CURVE25519
#define HAVE_FFDHE_2048
#define WC_RSA_PSS
#define WOLFSSL_PSS_LONG_SALT
#define WOLFSSL_PSS_SALT_LEN_DISCOVER
#define WOLFSSL_RSA_VERIFY_INLINE
#define HAVE_AESGCM
#define HAVE_HKDF
#define HAVE_HASHDRBG
#define WOLFSSL_BASE64_ENCODE
#define WOLFSSL_SHA256
#define WOLFSSL_SHA384
#define WOLFSSL_SHA3
#define WOLFSSL_SHA512
#define WOLFSSL_SHAKE128
#define WOLFSSL_SHAKE256
#define HAVE_SERVER_INDICATION
#define WOLFSSL_DH_CONST
#define WOLFSSL_NO_SOCK
#define WOLFSSL_USER_IO
#define XMALLOC_USER
#define NO_INT128
#define NO_ASN_TIME_CHECK

#ifdef CONFIG_APP_BENCH_WOLFSSL_DEBUG
#define DEBUG_WOLFSSL
#endif

/*
 * RSA-PSS-15360 certificates need big-integer operations beyond the default
 * SP math limits. Heap math keeps those very large RSA verifies dynamic instead
 * of requiring a huge fixed FP_MAX_BITS buffer on the nRF52840.
 */
#define USE_INTEGER_HEAP_MATH
#define RSA_MAX_SIZE 16384

#ifdef CONFIG_WOLFSSL_MLKEM
#define WOLFSSL_HAVE_MLKEM
#define WOLFSSL_PQC_HYBRIDS
#endif

#ifdef CONFIG_APP_BENCH_MLKEM_BACKEND_PQM4_CLEAN
#define WOLF_CRYPTO_CB
#define WOLF_CRYPTO_CB_FIND
#define WOLF_CRYPTO_CB_ONLY_PQC
#define MAX_CRYPTO_DEVID_CALLBACKS 16
#endif

/*
 * Keep these enabled for benchmark builds so certificate signature variants
 * can be probed. Unsupported combinations are reported by the runner instead
 * of falling back to a different algorithm silently.
 */
#define WOLFSSL_HAVE_MLDSA
#define WOLFSSL_MLDSA_VERIFY_SMALL_MEM
#define WOLFSSL_HAVE_SLHDSA
#define WOLFSSL_WC_SLHDSA

#endif
```

## src/wolfmqtt_settings.h
```c
#ifndef APP_BENCH_WOLFMQTT_SETTINGS_H
#define APP_BENCH_WOLFMQTT_SETTINGS_H

#define ENABLE_MQTT_TLS

#endif
```
